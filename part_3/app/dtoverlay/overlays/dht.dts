/* Raspberry Pi DHT sensor device tree fragment example.
   Configured for DHT sensor connected to Pi GPIO 18.
*/
/dts-v1/;
/plugin/;

&soc {

  dht11@18 {
    compatible = "dht11";
    gpios = <&gpio 18 0>;
  };

};
